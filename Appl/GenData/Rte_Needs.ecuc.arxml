AUTOSAR XML (schema 4-0-3)
package /DaVinci_Project
  module config Rte
    5 x RteBswModuleInstance:
      BswM
        BswM_MainFunctionTimingEvent0 (RteBswEventToTaskMapping): RteBswUsedOsAlarmRef=Os/Rte_Al_TE2_BswTask_0_10ms
      Dio
      EcuM
        EcuM_MainFunctionTimingEvent0 (RteBswEventToTaskMapping): RteBswUsedOsAlarmRef=Os/Rte_Al_TE2_BswTask_0_10ms
      Mcu
      Port
    4 x RteSwComponentInstance:
      BswM_EcuSwComposition
        Timer_BswM_MainFunction (RteEventToTaskMapping): RteUsedOsAlarmRef=Os/Rte_Al_TE2_BswTask_0_10ms
      EcuM_EcuSwComposition
        Timer_EcuM_MainFunction (RteEventToTaskMapping): RteUsedOsAlarmRef=Os/Rte_Al_TE2_BswTask_0_10ms
      Os_OsCore0_swc_EcuSwComposition
      test_swc_EcuSwComposition
        TMT_test_swc_Runnable (RteEventToTaskMapping): RteUsedOsEventRef=Rte_Ev_Run_test_swc_Runnable, RteUsedOsAlarmRef=Os/Rte_Al_TE_test_swc_Runnable
    RteOsInteraction
      Rte_Al_TE_test_swc_Runnable (RteUsedOsActivation): RteExpectedActivationOffset=0, RteActivationOsAlarmRef=Os/Rte_Al_TE_test_swc_Runnable, RteActivationOsTaskRef=AppTask
      Rte_Al_TE2_BswTask_0_10ms (RteUsedOsActivation): RteExpectedActivationOffset=0, RteActivationOsAlarmRef=Os/Rte_Al_TE2_BswTask_0_10ms, RteActivationOsTaskRef=BswTask
  module config NvM
  module config Os
    AppTask (OsTask): OsTaskActivation=1, OsTaskPriority=0, OsTaskSchedule=FULL, OsTaskEventRef=Rte_Ev_Run_test_swc_Runnable
    Rte_Al_TE_test_swc_Runnable (OsAlarm): OsAlarmCounterRef=SystemTimer
      OsAlarmAction
        OsAlarmSetEvent: OsAlarmSetEventRef=Rte_Ev_Run_test_swc_Runnable, OsAlarmSetEventTaskRef=AppTask
    BswTask (OsTask): OsTaskActivation=1, OsTaskPriority=0, OsTaskSchedule=FULL
    Rte_Al_TE2_BswTask_0_10ms (OsAlarm): OsAlarmCounterRef=SystemTimer
      OsAlarmAction
        OsAlarmActivateTask: OsAlarmActivateTaskRef=BswTask
    Rte_Ev_Run_test_swc_Runnable (OsEvent)
  module config EcuC
  ecuc value collection DaVinci_Project: ecuc-values=[Com, Rte, Os, EcuC, NvM]
